/*
*	himax dtsi
*/

&i2c_4 {
	status = "ok";
	#address-cells = <1>;
	#size-cells = <0>;

	himax@48 {
		compatible = "himax,hxcommon";
		reg = <0x48>;
		himax,panel-coords = <0 1080 0 2520>;
		himax,display-coords = <0 1080 0 2520>;
		himax,irq-gpio = <&gpa2 4 0>;
		himax,rst-gpio = <&gpa1 3 0>;
		report_type = <1>;
	};
};
