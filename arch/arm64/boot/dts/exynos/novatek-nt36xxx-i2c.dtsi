/*
 * Copyright (C) 2010 - 2017 Novatek, Inc.
 *
 * $Revision: 22971 $
 * $Date: 2018-02-08 16:05:40 +0800 (週四, 08 二月 2018) $
 *
 * This program is free software; you can redistribute it and/or modify
 * it under the terms of the GNU General Public License as published by
 * the Free Software Foundation; either version 2 of the License, or
 * (at your option) any later version.
 *
 * This program is distributed in the hope that it will be useful, but WITHOUT
 * ANY WARRANTY; without even the implied warranty of MERCHANTABILITY or
 * FITNESS FOR A PARTICULAR PURPOSE.  See the GNU General Public License for
 * more details.
 *
 */


&i2c_4 {
	status = "ok";
	#address-cells = <1>;
	#size-cells = <0>;
	samsung,i2c-max-bus-freq = <400000>;
	/* Novatek device tree node */
	novatek@62 {
		compatible = "novatek,NVT-ts";
		reg = <0x62>;

		novatek,reset-gpio = <&gpa1 3 0>;
		novatek,irq-gpio = <&gpa2 4 0>;

		pinctrl-names = "on_state", "off_state";
		pinctrl-0 = <&vdd_on>;
		pinctrl-1 = <&vdd_off>;
	};
};
