/*
 * SAMSUNG EXYNOS9820 SoC device tree source
 *
 * Copyright (c) 2018 Samsung Electronics Co., Ltd.
 *		http://www.samsung.com
 *
 * SAMSUNG EXYNOS9820 SoC device nodes are listed in this file.
 * EXYNOS9820 based board files can include this file and provide
 * values for board specfic bindings.
 *
 * This program is free software; you can redistribute it and/or modify
 * it under the terms of the GNU General Public License version 2 as
 * published by the Free Software Foundation.
 */
&hsi2c_6 {
	status = "okay";
	samsung,reset-before-trans;
	clock-frequency = <400000>;

	aw8695_haptic@5A {
		compatible = "awinic,aw8695_haptic";
		reg = <0x5A>;
		pinctrl-names = "lra_int_status";
		pinctrl-0 = <&lra_int_status>;
		reset-gpio = <&gpa2 5 0>;
		irq-gpio = <&gpa2 7 0>;
		aw8695,cont_drv_lvl = <112>;
		aw8695,cont_drv_lvl_ov = <112>;
	};
};
