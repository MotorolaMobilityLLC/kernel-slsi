/*
 * SAMSUNG EXYNOS9610 board device tree source
 *
 * Copyright (c) 2017 Samsung Electronics Co., Ltd.
 *		http://www.samsung.com
 *
 * This program is free software; you can redistribute it and/or modify
 * it under the terms of the GNU General Public License version 2 as
 * published by the Free Software Foundation.
 */

/dts-v1/;
/plugin/;

#include "exynos9610-troika-camera.dtsi"
#include "exynos9610-troika-common.dtsi"

/ {
	compatible = "samsung,exynos9610", "samsung,Robusta2 Play EVB";
	board_id = <0x1>;
	board_rev = <0x0>;

	fragment@model {
		target-path = "/";
		__overlay__ {
			#address-cells = <2>;
			#size-cells = <1>;
			model = "Samsung Robusta2 Play EVB board based on EXYNOS9610";
		}; /* end of __overlay__ */
	}; /* end of fragment */
}; /* end of root */
#include "exynos9610-mot-troika.dtsi"
