/*
 * SAMSUNG EXYNOS9610 SoC device tree source
 *
 * Copyright (c) 2017 Samsung Electronics Co., Ltd.
 *		http://www.samsung.com
 *
 * SAMSUNG EXYNOS9610 SoC device nodes are listed in this file.
 * EXYNOS9610 based board files can include this file and provide
 * values for board specfic bindings.
 *
 * This program is free software; you can redistribute it and/or modify
 * it under the terms of the GNU General Public License version 2 as
 * published by the Free Software Foundation.
 */

/dts-v1/;
#include "exynos9610.dtsi"

/ {
	compatible = "samsung,armv8", "samsung,exynos9610";
	interrupt-parent = <&gic>;
};
