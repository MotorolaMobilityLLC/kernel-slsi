/*
 * Copyright (C) 2010 - 2017 Novatek, Inc.
 *
 * $Revision: 22971 $
 * $Date: 2018-02-08 16:05:40 +0800 (週四, 08 二月 2018) $
 *
 * This program is free software; you can redistribute it and/or modify
 * it under the terms of the GNU General Public License as published by
 * the Free Software Foundation; either version 2 of the License, or
 * (at your option) any later version.
 *
 * This program is distributed in the hope that it will be useful, but WITHOUT
 * ANY WARRANTY; without even the implied warranty of MERCHANTABILITY or
 * FITNESS FOR A PARTICULAR PURPOSE.  See the GNU General Public License for
 * more details.
 *
 */


&hsi2c_7 {
	status = "okay";
	samsung,reset-before-trans;
	clock-frequency = <400000>;
	sx933x@28 {
		compatible = "Semtech,sx933x";
		reg = <0x28>;
		Semtech,nirq-gpio = <&gpa2 6 0>; /* IRQ */
		pinctrl-names = "default";
		pinctrl-0 = <&cap_int_status>;
		Semtech,button-flag = <0x15>;
		Semtech,reg-num = <23>;
		Semtech,reg-init = <0x8020 0x1F0000
			0x8024 0x300008d7 /*again 6.6pf*/
			0x8028 0x24928000
			0x802C 0x300010d7
			0x8030 0x24960000
			0x8034 0x300010d7
			0x8038 0x24B20000
			0x803C 0x300004D4
			0x8040 0x25920000
			0x8044 0x300004D4
			0x8048 0x2C920000
			0x8054 0x02103010 /*ph0*/
			0x8058 0x20600C00
			0x805c 0x0
			0x8064 0x00900000 /*5mm th*/
			0x8070 0x0
			0x8074 0x02103110 /*ph1*/
			0x8084 0x00BB0000 /*5mm th*/
			0x8094 0x02103810 /*ph2*/
			0x80A4 0x00C60000 /*5mm th*/
			0x80B4 0x0010FF00
			0x80D4 0x00105A00
			0x4004 0x67 >;
		};


};
