/*
 * SAMSUNG EXYNOS9610 board device tree source
 *
 * Copyright (c) 2013 Samsung Electronics Co., Ltd.
 *		http://www.samsung.com
 *
 * This program is free software; you can redistribute it and/or modify
 * it under the terms of the GNU General Public License version 2 as
 * published by the Free Software Foundation.
 */

/ {
	fragment@battery {
		target-path = "/";
		__overlay__ {
			battery {
				status = "okay";

				pinctrl-names = "default";

				battery,vendor = "SDI SDI";
				battery,charger_name = "s2mu106-charger";
				battery,smallcharger_name = "s2mcs02-charger";
				battery,fuelgauge_name = "s2mu106-fuelgauge";
				battery,technology = <2>; /* POWER_SUPPLY_TECHNOLOGY_LION */

				battery,temp_high = <500>;
				battery,temp_high_recovery = <450>;
				battery,temp_low = <100>;
				battery,temp_low_recovery = <150>;
				battery,low_temp_limit = <100>;

				battery,chg_float_voltage = <4400>;
				battery,full_check_count = <3>;
				battery,chg_full_vcell = <4360>;
				battery,chg_recharge_vcell = <4300>;

				battery,max_rawsoc = <990>;
				battery,max_rawsoc_offset = <10>;

				battery,default_input_current = <1000>;
				battery,default_charging_current = <1000>;
				battery,default_full_check_current = <300>;

				battery,max_input_current = <3000>;
				battery,max_charging_current = <3000>;

				battery,pdo_max_input_vol = <5000>; /* mV */
				battery,pdo_max_chg_power = <15000>; /* mW */

				battery,small_input_current = <1000>;
				battery,small_charging_current = <1000>;

				/* Order of current setting must be same with
				* POWER_SUPPLY_TYPE_ of power_supply.h
				*/
				battery,input_current_limit =
					<500 450 500 2000 500 1500 1500 1000 1500 1500
					1000 500 500 3000 1200 500 450>;
				battery,fast_charging_current =
					<500 450 500 2000 500 1500 1500 1000 1500 1800
					1000 500 500 3000 2500 500 450>;
				battery,full_check_current =
					<175 0 175 175 175 175 175 175 175 175
					175 175 175 175 175 175 0>;


				/*moto begin*/
				moto,fastchg-current-ma = <3000>;
				moto,chg-thermal-mitigation = <3000>, <2500>,<2000>, <1500>,
								<1000>,<700>, <600>;
				/delete-property/ moto,dc-thermal-mitigation;
				moto,parallel-charge-current-map = <3000 3000 0>,
								<2500 2500 0>,
								<2000 2000 0>,
								<1500 1500 0>,
								<1000 1000 0>,
								<700 700 0>,
								<600 600 0>;
				moto,stepchg-voltage-mv = <4200>;
				moto,stepchg-current-ma = <2000>;
				moto,stepchg-taper-ma = <1800>;
				moto,stepchg-iterm-ma = <150>;
				moto,enable-hvdcp-9v;
				moto,weak-charger-check-enable;
				moto,temp-warm-current-ma = <1700>;
				moto,temp-cool-current-ma = <680>;
				moto,temp-slightly-cool-current-ma = <1700>;
				moto,slightly-cool-temp-c = <15>;
				moto,enable-charging-limit;
				moto,upper-limit-capacity = <75>;
				moto,lower-limit-capacity = <60>;
				moto,iterm-ma = <100>;
				moto,iterm-disabled;
				/delete-property/ moto,autoadjust-vfloat;
				moto,float-voltage-mv = <4400>;
				moto,resume-delta-mv = <200>;
				moto,chg-inhibit-fg;
				moto,rparasitic-uohm = <100000>;
				moto,bms-psy-name = "bms";
				moto,charge-unknown-battery;
				moto,hot-temp-c = <60>;
				moto,cold-temp-c = <(-20)>;
				moto,warm-temp-c = <45>;
				moto,cool-temp-c = <0>;
				moto,ext-temp-volt-mv = <4200>;
				moto,hotspot-thrs-c = <50>;
				moto,charging-timeout-mins = <0>;
				moto,precharging-timeout-mins = <0>;
				moto,bmd-algo-disabled;
				moto,bmd-pin-src = "bpd_none";
				moto,usbid-gpio-enabled;
				moto,auto-voltage-comp-mv = <150>;
				df-serialnum = "SB18C43602";
				/*moto end*/

				/* battery data for cell1 */
				serialnum_cell1 = "SB18C43602";
				battery,battery_table3_cell1 =
					<88 11 214 10 84 10 218 9 100 9
					243 8 140 8 34 8 205 7 123 7
					8 7 198 6 151 6 113 6 84 6
					57 6 15 6 234 5 175 5 133 5
					253 4 178 1 105 8 0 8 151 7
					45 7 196 6 90 6 241 5 135 5
					30 5 181 4 75 4 226 3 120 3
					15 3 166 2 60 2 211 1 105 1
					0 1 150 0 45 0 218 15>;

				battery,battery_table4_cell1 =
					<33 33 33 33 33 33 33 33 33 32
					32 33 33 33 33 34 34 34 34 36
					38 124>;

				battery,batcap_cell1 = <0xB0 0x36 0xAC 0x0D>; /* [0x0E] [0x0F] [0x10] [0x11] */
				battery,accum_cell1 = <0x8 0x00>; /* [0x45] [0x44] */

				battery,soc_arr_val_cell1 =
					<10514 10000 9485 8970 8455 7941 7426 6911 6396 5882
					5367 4852 4338 3823 3308 2793 2279 1764 1249 734
					220 (-185)>;
				battery,ocv_arr_val_cell1 =
					<44179 43544 42910 42315 41740 41188 40683 40167 39749 39351
					38791 38469 38237 38054 37911 37778 37574 37390 37106 36900
					36236 32120>;

				/* battery data for cell2 */
				serialnum_cell2 = "SB18C30735";
				battery,battery_table3_cell2 =
					<88 11 214 10 84 10 218 9 100 9
					243 8 140 8 34 8 205 7 123 7
					8 7 198 6 151 6 113 6 84 6
					57 6 15 6 234 5 175 5 133 5
					253 4 178 1 105 8 0 8 151 7
					45 7 196 6 90 6 241 5 135 5
					30 5 181 4 75 4 226 3 120 3
					15 3 166 2 60 2 211 1 105 1
					0 1 150 0 45 0 218 15>;

				battery,battery_table4_cell2 =
					<33 33 33 33 33 33 33 33 33 32
					32 33 33 33 33 34 34 34 34 36
					38 124>;

				battery,batcap_cell2 = <0xB0 0x36 0xAC 0x0D>; /* [0x0E] [0x0F] [0x10] [0x11] */
				battery,accum_cell2 = <0x8 0x00>; /* [0x45] [0x44] */

				battery,soc_arr_val_cell2 =
					<10514 10000 9485 8970 8455 7941 7426 6911 6396 5882
					5367 4852 4338 3823 3308 2793 2279 1764 1249 734
					220 (-185)>;
				battery,ocv_arr_val_cell2 =
					<44179 43544 42910 42315 41740 41188 40683 40167 39749 39351
					38791 38469 38237 38054 37911 37778 37574 37390 37106 36900
					36236 32120>;

				battery,battery_param_ver_cell2 = <0x01>;
			};
		};
	};
};
