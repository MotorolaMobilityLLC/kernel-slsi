## drivers/input/egistec/Kconfig
```kconfig
#
# Input misc drivers configuration
#


config INPUT_EGISTEC_320
	tristate "Egistec ET320 fingerprint sensor"
	default n
	help
	 Say Y here if you wish to include support for EGIS finger print sensor.
	 If unsure, say N.
```

## drivers/media/platform/exynos/fimc-is2/sensor/module_framework/eeprom/Kconfig
```kconfig
menuconfig CAMERA_EEPROM_SELECT
	bool "Sensor eeprom select"
	depends on USE_DIRECT_IS_CONTROL
	help
	  Say Y here to enable support for platform-specific V4L drivers.

config CAMERA_EEPROM_GM1_OBJ
	bool "Use GM1 EEPROM"
	depends on USE_DIRECT_IS_CONTROL
	depends on CAMERA_EEPROM_SELECT
	default n
	help
	  Use to build GM1 eeprom driver.

config CAMERA_EEPROM_5E9_OBJ
	bool "Use 5E9 EEPROM"
	depends on USE_DIRECT_IS_CONTROL
	depends on CAMERA_EEPROM_SELECT
	default n
	help
	  Use to build 5E9 eeprom driver.

config CAMERA_EEPROM_12A10_OBJ
	bool "Use 12A10 EEPROM"
	depends on USE_DIRECT_IS_CONTROL
	depends on CAMERA_EEPROM_SELECT
	default n
	help
	  Use to build 12A10 eeprom driver.

config CAMERA_EEPROM_12A10FF_OBJ
	bool "Use 12A10FF EEPROM"
	depends on USE_DIRECT_IS_CONTROL
	depends on CAMERA_EEPROM_SELECT
	default n
	help
	  Use to build 12A10FF eeprom driver.

config CAMERA_EEPROM_16885C_OBJ
	bool "Use 16885C EEPROM"
	depends on USE_DIRECT_IS_CONTROL
	depends on CAMERA_EEPROM_SELECT
	default n
	help
	  Use to build 16885C eeprom driver.
```

## drivers/media/platform/exynos/fimc-is2/vendor/Kconfig
```kconfig
menu "Vendor Feature Setting"
	depends on EXYNOS_FIMC_IS

choice
	prompt "Use vender features"
	depends on EXYNOS_FIMC_IS
	default VENDER_DEFAULT
	help
	  Use the vender specific features.

config VENDER_DEFAULT
        bool "Default"
config VENDER_PSV
        bool "PSV"
endchoice

source "drivers/media/platform/exynos/fimc-is2/vendor/default/Kconfig"
endmenu
```

## drivers/misc/aw8695_haptic/Kconfig
```kconfig
config AW8695_HAPTIC
    tristate "Haptic driver for awinic AW8695 series"
    depends on I2C
    help
      This option enables support for AW8695 series Haptic Driver.
```

## drivers/misc/modem_if/Kconfig
```kconfig
menuconfig SEC_MODEM_IF
	bool "Samsung Mobile Modem Interface"
	default n
	---help---
	  Samsung Modem Interface Driver

if SEC_MODEM_IF

config MODEM_CHIP_MODAP_S3XXAP
	bool "Exynos ModAP S3XXAP"
	select MODEMCTRL_MODAP_S3XXAP
	select LINK_DEVICE_SHMEM
	select MCU_IPC
	select SHM_IPC
	select CP_PMUCAL
	select CP_SECURE_BOOT
	select LINK_DEVICE_NAPI
	select MODEM_IF_NET_GRO
	select CACHED_RAW_RX_BUFFER
	default n

menu "Configurations"
config MODEMCTRL_MODAP_S3XXAP
	bool "Control device: Exynos ModAP S3xxAP"
	default n

config LINK_DEVICE_SHMEM
	bool "Link device: shared memory"
	default n

config LINK_DEVICE_NAPI
	bool "Use Rx polling (NAPI)"
	depends on SEC_MODEM_IF
	default n
	help
	NAPI is a new driver API designed to reduce CPU and interrupt load
	when the driver is receiving lots of packets.

config CP_SECURE_BOOT
	bool "Support CP Secure Boot"
	default n

config DEBUG_MODEM_IF
	bool "Enable debug option"
	default n

config SIM_DETECT
	bool "Detect SIM by GPIO"
	default n

config MODEM_IF_ADAPTIVE_QOS
	bool "Enable Adaptive QOS for high data performance"
	default n

config MODEM_IF_NET_GRO
	bool "enable GRO feature"
	depends on LINK_DEVICE_NAPI
	default n
	---help---
	 This enables GRO(Generic Receive Offload) feature

config CACHED_RAW_RX_BUFFER
	bool "Set cached RX RAW BUFFER for high data performance"
	default n

config UART_SWITCH
	bool "UART SWITCH Support"
	default n

config HW_REV_DETECT
        bool "Support HW REV Detect"
        default n

endmenu
endif
```

## drivers/muic/Kconfig
```kconfig
#
# MUIC devices
#

comment "MUIC configs"

config USE_MUIC
	bool "Using MUIC device driver"
	depends on I2C
	default n
	help
	  If you say yes here you will get support for
	  the MUIC device driver.

config USE_SAFEOUT
	bool "Using SAFEOUT device driver"
	depends on I2C
	default n
	help
	  If you say yes here you will get support for
	  the SAFEOUT device driver.

config MUIC_NOTIFIER
	bool "MUIC notifier support"
	depends on USE_MUIC
	default n
	help
	  If you say yes here you will get support for
	  the MUIC attached device status change notification.

config MUIC_MAX77705
        bool "Using MAX77705 MUIC"
        depends on USE_MUIC
        default n
        help
          If you say yes here you will get support for
          the MAX77705 MUIC chip.
	  To enable this driver,
	  USE_MUIC should be enabled.

config HV_MUIC_MAX77705_AFC
        bool "Using MAX77705 AFC MUIC"
        depends on MUIC_MAX77705
        default n
        help
          If you say yes here you will get support for
	  the MAX77705 AFC MUIC.
	  To enable this driver,
	  MUIC_MAX77705 should be enabled.

config MUIC_UNIVERSAL
	bool "UNIVERSAL MUIC"
	depends on USE_MUIC
	default n
	help
	  If you say yes here you will get support for various MUIC chips.

config MUIC_UNIVERSAL_MAX77854
	bool "MAX77854 MUIC"
	depends on MUIC_UNIVERSAL
	default n
	help
	  If you say yes here you will get support for the MAX77854 MUIC chip.

config MUIC_UNIVERSAL_MAX77865
	bool "MAX77865 MUIC"
	depends on MUIC_UNIVERSAL
	default n
	help
	  If you say yes here you will get support for the MAX77865 MUIC chip.

config MUIC_MANAGER
	bool "MUIC Manager supports CCIC chip interface"
	depends on USE_MUIC && MFD_S2MU004
	default n
	help
	  If you say yes here you will get support manager for the CCIC chip.

config MUIC_HV
	bool "MUIC_HV"
	depends on MUIC_UNIVERSAL
	default n
	help
	  If you say yes here you will get support for the AFC.

config MUIC_HV_12V
	bool "MUIC_HV_12V"
	depends on MUIC_HV
	default n
	help
	  If you say yes here you will get support for the AFC.

config MUIC_HV_MAX77854
	bool "MUIC_HV_MAX77854"
	depends on MUIC_UNIVERSAL_MAX77854
	default n
	help
	  If you say yes here you will get support for the AFC.

config MUIC_HV_MAX77865
	bool "MUIC_HV_MAX77865"
	depends on MUIC_UNIVERSAL_MAX77865
	default n
	help
	  If you say yes here you will get support for the AFC.

config MUIC_SUPPORT_CCIC
	bool "MUIC supports CCIC chip interface"
	default n
	help
	  If you say yes here you will get support for the CCIC chip.

config MUIC_MAX77705_CCIC
        bool "Using MAX77705 MUIC supports CCIC chip interface"
        depends on MUIC_MAX77705 && MUIC_SUPPORT_CCIC
        default n
        help
          If you say yes here you will get support for
	  the CCIC chip with MAX77705 MUIC.
	  To enable this driver,
	  MUIC_MAX77705 and MUIC_SUPPORT_CCIC should be enabled.

config MUIC_TEST_FUNC
	bool "MUIC supports several function's in TEST"
	depends on SEC_DEBUG && !SAMSUNG_PRODUCT_SHIP
	default n
	help
	  If you say yes here you will get support for the TEST function's.

config HICCUP_CHARGER
	bool "Using HICCUP charger"
	depends on USE_MUIC
	default n
	help
		If you say yes here you will get support for
		for the hiccup charger feature.

config MUIC_S2MU004
	bool "Using S2MU004 MUIC"
	depends on USE_MUIC && MFD_S2MU004
	default n
	help
	  If you say yes here you will get support for the S2MU004 MUIC chip.

config MUIC_S2MU004_HV
	bool "Using S2MU004 MUIC High Voltage Charging"
	depends on MUIC_S2MU004
	default n
	help
	  If you say yes here you will get support for
	  the HV voltage control functionality.
          It will support afc and qc,
          to implement this config.

config MUIC_S2MU004_ENABLE_AUTOSW
	bool "Using S2MU004 ENABLE AUTOSW"
	depends on MUIC_S2MU004
	default n
	help
	  If you say yes here you will get support for the AUTO switch path.

config MUIC_S2MU004_RID
	bool "Using S2MU004 MUIC RID"
	depends on MUIC_S2MU004
	default n
	help
	  If you say yes here,
          you will get support for MUIC RID.
          Usually it's used for the JIG Factory ID,
          and the accessory.

config HV_MUIC_VOLTAGE_CTRL
	bool "Using AFC Voltage control functionality"
	depends on MUIC_HV_S2MU004_AFC
	default n
	help
	  If you say yes here you will get support for
	  the AFC voltage control functionality.

config MUIC_S2MU005
	bool "Using S2MU005 MUIC"
	depends on USE_MUIC && MFD_S2MU005
	default n
	help
	  If you say yes here you will get support for
	  for the S2MU005 MUIC chip.

config MUIC_S2MU005_ENABLE_AUTOSW
	bool "Using S2MU005 MUIC ENABLE AUTOSW"
	depends on MUIC_S2MU005
	default n
	help
	  If you say yes here you will get support for
	  for the S2MU005 MUIC chip ENABLE AUTOSW feature.

config MUIC_S2MU005_DISCHARGING_WA
	bool "Using S2MU005 MUIC DISCHARGING WORKAROUND"
	depends on MUIC_S2MU005
	default n
	help
		If you say yes here you will get support for
		for the S2MU005 MUIC chip DISCHARGING WA feature.
```

## drivers/soc/samsung/Kconfig
```kconfig
#
# SAMSUNG SoC drivers
#
menuconfig SOC_SAMSUNG
	bool "Samsung SoC driver support" if COMPILE_TEST

if SOC_SAMSUNG
config EXYNOS_CHIPID
	bool "Exynos Chip ID Driver Support"
	depends on ARCH_EXYNOS
	select SOC_BUS

config EXYNOS_BCM
	bool "EXYNOS_BCM driver support"
	help
	  Enable exynos_bcm driver support

config CAL_IF
	bool "Exynos Chip Abstraction Layer Interface"
	help
	  Support CMU CAL for Exynos SoC.

config EXYNOS_REBOOT
	bool "Exynos Chip Reboot Driver Support"
	depends on ARCH_EXYNOS

config CMUCAL
	bool "Exynos CMU Chip Abstraction Layer"
	depends on CAL_IF
	default y
	help
	Support CMUCAL for Exynos SoC.

config CMUCAL_DEBUG
	bool "CMUCAL Debug Interface"
	depends on CMUCAL

config CMUCAL_QCH_IGNORE_SUPPORT
	bool "CMUCAL QCH IGNORE Support"
	depends on CMUCAL

source "drivers/soc/samsung/acpm/Kconfig"

config ACPM_DVFS
	bool "Exynos ACPM DVFS manager"
	depends on CAL_IF && CMUCAL
	default y
	help
	Support ACPM DVFS for Exynos SoC.

config PMUCAL
	bool "Exynos PMU Chip Abstraction Layer"
	depends on CAL_IF
	default y
	help
	Support PMUCAL for Exynos SoC.

config CP_PMUCAL
	bool "Exynos PMU(for CP) Chip Abstraction Layer"
	depends on CAL_IF
	help
	  Support CP_PMUCAL for Exynos SoC.

config GNSS_PMUCAL
	bool "Exynos PMU(for GNSS) Chip Abstraction Layer"
	depends on CAL_IF
	help
	  Support GNSS_PMUCAL for Exynos SoC.

config EXYNOS_PMU
	bool "Exynos Power Management Unit Driver Support"
	depends on ARCH_EXYNOS
	select MFD_SYSCON

config ECT
	bool "Enable Exynos Characteristic Table File"
	default n
	depends on ARCH_EXYNOS

config ECT_DUMP
	bool "Enable Exynos Characteristic Table File Dump sysfs"
	default n
	depends on ECT

config EXYNOS_RGT
	bool "Exynos Regulator Debug Support"
	depends on REGULATOR
	depends on DEBUG_FS
	depends on OF
	help
	  dummy device driver for debugging samsung PMIC

# There is no need to enable these drivers for ARMv8
config EXYNOS_PM_DOMAINS
	bool "Exynos PM domains" if COMPILE_TEST
	depends on PM_GENERIC_DOMAINS || COMPILE_TEST

source "drivers/soc/samsung/debug/Kconfig"
config EXYNOS_DVFS_MANAGER
	bool "Exynos DVFS Manager"
	default n
	depends on ARCH_EXYNOS
	help
	  Enable DVFS Manager for Exynos SoC.
	  This module controls constraint between each DVFS domains.

config EXYNOS_PD
	bool "Exynos PM domain Support"
		depends on ARCH_EXYNOS
		depends on PM
		select PM_GENERIC_DOMAINS

endif
```

## drivers/soc/samsung/debug/Kconfig
```kconfig
menuconfig EXYNOS_DEBUG
        bool "Exynos Debug Features"
        default y
        depends on ARCH_EXYNOS

if EXYNOS_DEBUG

config EXYNOS_ITMON
        bool "Exynos IPs Traffic Monitor"
        default y
        depends on ARCH_EXYNOS
endif
```

## drivers/video/fbdev/exynos/dpu20/panels/Kconfig
```kconfig
config EXYNOS_DECON_LCD
	depends on EXYNOS_DPU20
	bool "Select LCD panel driver"
config EXYNOS_DECON_LCD_MULTI
	depends on EXYNOS_DECON_LCD && EXYNOS_MIPI_DSIM
	tristate "Support Muli panel drivers"

config EXYNOS_DECON_LCD_S6E3HA2K
	depends on EXYNOS_DECON_LCD && EXYNOS_MIPI_DSIM
	tristate "S6E3HA2K AMOLED WQHD LCD driver(1440 x 2560)"

config EXYNOS_DECON_LCD_S6E3HF4
	depends on EXYNOS_DECON_LCD && EXYNOS_MIPI_DSIM
	tristate "S6E3HF4 AMOLED WQHD LCD driver(1440 x 2560)"
	default n

config EXYNOS_DECON_LCD_S6E3HA6
	depends on EXYNOS_DECON_LCD && EXYNOS_MIPI_DSIM
	tristate "S6E3HA6 AMOLED WQHD+ LCD driver(1440 x 2960)"
	default n

config EXYNOS_DECON_LCD_S6E3HA8
	depends on EXYNOS_DECON_LCD && EXYNOS_MIPI_DSIM
	tristate "S6E3HA8 AMOLED WQHD+ LCD driver(1440 x 2960)"
	default n

config EXYNOS_DECON_LCD_S6E3AA2
	depends on EXYNOS_DECON_LCD && EXYNOS_MIPI_DSIM
	tristate "S6E3AA2 AMOLED HD LCD driver(720 x 1280)"
	default n

config EXYNOS_DECON_LCD_S6E3FA0
	depends on EXYNOS_DECON_LCD && EXYNOS_MIPI_DSIM
	tristate "S6E3FA0 AMOLED HD LCD driver(1080 x 1920)"
	default n

config EXYNOS_DECON_LCD_S6E3FA7
	depends on EXYNOS_DECON_LCD && EXYNOS_MIPI_DSIM
	tristate "S6E3FA7 AMOLED FHD LCD driver(1080 x 2220)"
	default n

config EXYNOS_DECON_LCD_EMUL_DISP
	depends on EXYNOS_DECON_LCD && EXYNOS_MIPI_DSIM
	tristate "Virtual LCD driver for emulator(800 x 1280)"
```

## drivers/vision/vipx/Kconfig
```kconfig
menuconfig EXYNOS_VIPX
        bool "Exynos VIPx driver"
        select EXYNOS_VIPX_PLATFORM
        select EXYNOS_VIPX_INTERFACE
        help
          This is a vision image processing unit

if EXYNOS_VIPX

source "drivers/vision/vipx/platform/Kconfig"
source "drivers/vision/vipx/interface/Kconfig"

endif
```

## drivers/vision/vipx/interface/Kconfig
```kconfig
config EXYNOS_VIPX_INTERFACE
	bool "Select Interface"
	help
	  This is VIPx interface

config EXYNOS_VIPX_HARDWARE
	bool "Use Hardware"
	depends on EXYNOS_VIPX_INTERFACE
	help
	  This is hardware device

choice
	prompt "Select Message box type"
	depends on EXYNOS_VIPX_INTERFACE
	help
	  Select VIP(x) message box type.

config EXYNOS_VIPX_MBOX
	bool "Use VIPX MBOX"
	depends on EXYNOS_VIPX_INTERFACE
	help
	  This is message box device

config EXYNOS_EMUL_MBOX
	bool "Use EMUL MBOX"
	depends on EXYNOS_VIPX_INTERFACE
	help
	  This is message box emulator
endchoice
```

## drivers/vision/vipx/platform/Kconfig
```kconfig
menuconfig EXYNOS_VIPX_PLATFORM
	bool "Select Platform"
	help
	  This is a selection of platform

config EXYNOS_VIPX_EXYNOS9610
	bool "Use Exynos9610 platform"
	depends on EXYNOS_VIPX_PLATFORM
	depends on SOC_EXYNOS9610
	help
	  This is a exynos9610 platform
```

## sound/soc/samsung/abox/Kconfig
```kconfig
config SND_SOC_SAMSUNG_ABOX
	tristate "ASoC support for Samsung ABOX Audio"
	select REGMAP_MMIO
	select SND_SOC_COMPRESS
	help
	  Say Y or M if you want to add support for codecs attached to
	  the Samsung SoC ABOX interface. You will also need to
	  select the audio interfaces to support below.
```
